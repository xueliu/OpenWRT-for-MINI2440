## target/linux/mini2440/image/Config.in
```kconfig
config MINI2440_DFBOOT
	bool "Build dataflashboot loader"
	depends TARGET_mini2440
	default y

config MINI2440_UBOOT
	bool "Build U-Boot bootloader"
	depends TARGET_mini2440
	default y

config UBOOT_TARGET
	string "U-Boot target board"
	depends TARGET_mini2440
	depends MINI2440_UBOOT
	default "vlink"
	help
	  For all supported boards there are ready-to-use default
		configurations available; just type "<board_name>".

config UBOOT_IPADDR
	string "IP Address for U-Boot"
	depends TARGET_mini2440
	depends MINI2440_UBOOT
	default "192.168.0.178"
	help
	  IP address of device to be used in U-Boot

config UBOOT_SERVERIP
	string "IP Address of TFTP server"
	depends TARGET_mini2440
	depends MINI2440_UBOOT
	default "192.168.0.232"
	help
	  IP address of TFTP server for U-Boot
```
